## arch/arm/mach-imx/imx8m/Kconfig
```kconfig
if ARCH_IMX8M

config IMX8M
	bool
	select HAS_CAAM
	select ROM_UNIFIED_SECTIONS

config IMX8MQ
	bool
	select IMX8M
	select ARMV8_SPL_EXCEPTION_VECTORS

config IMX8MM
	bool
	select IMX8M
	select ARMV8_SPL_EXCEPTION_VECTORS

config IMX8MN
	bool
	select IMX8M
	select ARMV8_SPL_EXCEPTION_VECTORS

config IMX8MP
	bool
	select IMX8M

config SYS_SOC
	default "imx8m"

config SECONDARY_BOOT_SECTOR_OFFSET
	hex "SD/MMC sector offset used for ROM secondary boot"
	default 0x0
	depends on IMX8MQ || IMX8MM
	help
	  Set the sector offset to non-zero value in SPL used for
	  secondary boot image. This value should be same as the
	  firstSectorNumber in secondary image table.

config SECURE_STICKY_BITS_LOCKUP
	bool "Enable workaround to fix sticky bits lock up issue"
	depends on IMX8MQ && IMX_HAB
	default y

config IMX_UNIQUE_ID
	hex "Enable workaround to fix sticky bits lock up issue"
	depends on IMX8MQ && IMX_HAB && !SECURE_STICKY_BITS_LOCKUP
	default 0x0

config IMX8M_MCU_RDC_START_CONFIG_ADDR
	hex "Start address of mcu rdc config when mcu starts"
	default 0x186000

config IMX8M_MCU_RDC_STOP_CONFIG_ADDR
	hex "Start address of mcu rdc config when mcu stops"
	default 0x187000

choice
	prompt  "NXP i.MX8M board select"
	optional

config TARGET_IMX8MQ_EVK
	bool "imx8mq_evk"
	select IMX8MQ
	select IMX8M_LPDDR4
	select FSL_CAAM
	select FSL_BLOB
	select MISC
	select SPL_CRYPTO_SUPPORT if SPL

config TARGET_IMX8MQ_PHANBELL
        bool "imx8mq_phanbell"
        select IMX8MQ
        select IMX8M_LPDDR4

config TARGET_IMX8MQ_DDR3L_VAL
	bool "imx8mq_ddr3l_val"
	select IMX8MQ

config TARGET_IMX8MQ_DDR4_VAL
	bool "imx8mq_ddr4_val"
	select IMX8MQ
	select IMX8M_DDR4

config TARGET_IMX8MM_DDR4_VAL
	bool "imx8mm DDR4 validation board"
	select IMX8MM
	select SUPPORT_SPL
	select IMX8M_DDR4

config TARGET_IMX8MM_DDR3L_VAL
	bool "imx8mm DDR3L validation board"
	select IMX8MM
	select SUPPORT_SPL
	select IMX8M_DDR3L

config TARGET_IMX8MM_EVK
	bool "imx8mm LPDDR4 EVK board"
	select IMX8MM
	select SUPPORT_SPL
	select IMX8M_LPDDR4
	select FSL_CAAM
	select FSL_BLOB
	select MISC
	select SPL_CRYPTO_SUPPORT if SPL

config TARGET_IMX8MM_IWG34M
	bool "imx8mm LPDDR4 IWG34M board"
	select IMX8MM
	select SUPPORT_SPL
	select IMX8M_LPDDR4
	select FSL_CAAM
	select FSL_BLOB
	select MISC
	select SPL_CRYPTO_SUPPORT if SPL

config TARGET_IMX8MM_IWG34M_UUU
        bool "imx8mm LPDDR4 IWG34M board uuu"
        depends on TARGET_IMX8MM_IWG34M

config TARGET_IMX8MM_IWG34M_Q7
	bool "imx8mm LPDDR4 IWG34M board"
	select IMX8MM
	select SUPPORT_SPL
	select IMX8M_LPDDR4
	select FSL_CAAM
	select FSL_BLOB
	select MISC
	select SPL_CRYPTO_SUPPORT if SPL

config TARGET_IMX8MM_IWG34M_Q7_UUU
        bool "imx8mm LPDDR4 IWG34M board uuu"
        depends on TARGET_IMX8MM_IWG34M_Q7

config TARGET_IMX8MM_IWG34S
        bool "imx8mm LPDDR4 IWG34S board"
        select IMX8MM
        select SUPPORT_SPL
        select IMX8M_LPDDR4
        select FSL_CAAM
        select FSL_BLOB
        select MISC
        select SPL_CRYPTO_SUPPORT if SPL

config TARGET_IMX8MM_VENICE
	bool "Support Gateworks Venice iMX8M Mini module"
	select IMX8MM
	select SUPPORT_SPL
	select IMX8M_LPDDR4

config TARGET_IMX8MM_EVK_QCA
	bool "imx8mm LPDDR4 EVK Legacy QCA WIFI board"
	select IMX8MM
	select SUPPORT_SPL
	select IMX8M_LPDDR4

config TARGET_IMX8MM_DDR4_EVK
	bool "imx8mm DDR4 EVK board"
	select IMX8MM
	select SUPPORT_SPL
	select IMX8M_DDR4
	select FSL_CAAM
	select FSL_BLOB
	select MISC
	select SPL_CRYPTO_SUPPORT if SPL

config TARGET_IMX8MN_EVK
	bool "imx8mn LPDDR4 EVK board"
	select IMX8MN
	select SUPPORT_SPL
	select IMX8M_LPDDR4
	select FSL_CAAM
	select FSL_BLOB
	select MISC
	select SPL_CRYPTO_SUPPORT if SPL

config TARGET_IMX8MN_IWG37M
	bool "imx8mn LPDDR4 IWG37M board"
	select IMX8MN
	select SUPPORT_SPL
	select IMX8M_LPDDR4
	select FSL_CAAM
	select FSL_BLOB
	select MISC
	select SPL_CRYPTO_SUPPORT if SPL

config TARGET_IMX8MN_IWG37M_UUU
        bool "imx8mn LPDDR4 IWG37M board uuu"
        depends on TARGET_IMX8MN_IWG37M

config TARGET_IMX8MN_IWG37M_Q7
	bool "imx8mn LPDDR4 IWG37M board"
	select IMX8MN
	select SUPPORT_SPL
	select IMX8M_LPDDR4
	select FSL_CAAM
	select FSL_BLOB
	select MISC
	select SPL_CRYPTO_SUPPORT if SPL

config TARGET_IMX8MN_IWG37M_Q7_UUU
        bool "imx8mn LPDDR4 IWG37M board uuu"
        depends on TARGET_IMX8MN_IWG37M_Q7

config SDRAM_SIZE_1GB
	bool "Support 1GB LPDDR4 IWG34M and IWG37M Platform"
	depends on TARGET_IMX8MM_IWG34M || TARGET_IMX8MN_IWG37M || TARGET_IMX8MM_IWG34M_Q7 || TARGET_IMX8MN_IWG37M_Q7

config SDRAM_SIZE_2GB
	bool "Support 2GB LPDDR4 IWG34M and IWG37M Platform"
	depends on TARGET_IMX8MM_IWG34M || TARGET_IMX8MN_IWG37M || TARGET_IMX8MM_IWG34M_Q7 || TARGET_IMX8MN_IWG37M_Q7

config TARGET_IMX8MN_IWG37S
        bool "imx8mn LPDDR4 IWG37S board"
        select IMX8MN
        select SUPPORT_SPL
        select IMX8M_LPDDR4
        select FSL_CAAM
        select FSL_BLOB
        select MISC
        select SPL_CRYPTO_SUPPORT if SPL

config TARGET_IMX8MN_DDR4_EVK
	bool "imx8mn DDR4 EVK board"
	select IMX8MN
	select SUPPORT_SPL
	select IMX8M_DDR4
	select FSL_CAAM
	select FSL_BLOB
	select MISC
	select SPL_CRYPTO_SUPPORT if SPL

config TARGET_IMX8MN_DDR3_EVK
	bool "imx8mn 11x11 DDR3 EVK board"
	select IMX8MN
	select SUPPORT_SPL
	select IMX8M_DDR3L
	select FSL_CAAM
	select FSL_BLOB
	select MISC
	select SPL_CRYPTO_SUPPORT if SPL

config TARGET_IMX8MP_EVK
	bool "imx8mp LPDDR4 EVK board"
	select IMX8MP
	select SUPPORT_SPL
	select IMX8M_LPDDR4
	select FSL_CAAM
	select FSL_BLOB
	select MISC
	select SPL_CRYPTO_SUPPORT if SPL

config TARGET_PICO_IMX8MQ
	bool "Support Technexion Pico iMX8MQ"
	select IMX8MQ
	select IMX8M_LPDDR4

config TARGET_IMX8MP_DDR4_EVK
	bool "imx8mp DDR4 EVK board"
	select IMX8MP
	select SUPPORT_SPL
	select IMX8M_DDR4
	select FSL_CAAM
	select FSL_BLOB
	select MISC
	select SPL_CRYPTO_SUPPORT if SPL

config TARGET_IMX8MM_AB2
	bool "imx8mm LPDDR4 Audio board 2.0"
	select IMX8MM
	select SUPPORT_SPL
	select IMX8M_LPDDR4
	select FSL_CAAM
	select FSL_BLOB
	select MISC
	select SPL_CRYPTO_SUPPORT if SPL

config TARGET_IMX8MM_DDR4_AB2
	bool "imx8mm DDR4 Audio board 2.0"
	select IMX8MM
	select SUPPORT_SPL
	select IMX8M_DDR4
	select FSL_CAAM
	select FSL_BLOB
	select MISC
	select SPL_CRYPTO_SUPPORT if SPL

config TARGET_IMX8MN_AB2
	bool "imx8mn LPDDR4 Audio board 2.0"
	select IMX8MN
	select SUPPORT_SPL
	select IMX8M_LPDDR4
	select FSL_CAAM
	select FSL_BLOB
	select MISC
	select SPL_CRYPTO_SUPPORT if SPL

config TARGET_IMX8MN_DDR4_AB2
	bool "imx8mn DDR4 Audio board 2.0"
	select IMX8MN
	select SUPPORT_SPL
	select IMX8M_DDR4
	select FSL_CAAM
	select FSL_BLOB
	select MISC
	select SPL_CRYPTO_SUPPORT if SPL

config TARGET_IMX8MN_DDR3L_AB2
	bool "imx8mn DDR3L Audio board 2.0"
	select IMX8MN
	select SUPPORT_SPL
	select IMX8M_DDR3L
	select FSL_CAAM
	select FSL_BLOB
	select MISC
	select SPL_CRYPTO_SUPPORT if SPL

config TARGET_VERDIN_IMX8MM
       bool "Support Toradex Verdin iMX8M Mini module"
       select IMX8MM
       select SUPPORT_SPL
       select IMX8M_LPDDR4

config TARGET_IMX8MM_BEACON
	bool "imx8mm Beacon Embedded devkit"
	select IMX8MM
	select SUPPORT_SPL
	select IMX8M_LPDDR4

config TARGET_IMX8MN_BEACON
	bool "imx8mn Beacon Embedded devkit"
	select IMX8MN
	select SUPPORT_SPL
	select IMX8M_LPDDR4

config TARGET_PHYCORE_IMX8MM
	bool "PHYTEC PHYCORE i.MX8MM"
	select IMX8MM
        select SUPPORT_SPL
	select IMX8M_LPDDR4

config TARGET_PHYCORE_IMX8MP
	bool "PHYTEC PHYCORE i.MX8MP"
	select IMX8MP
        select SUPPORT_SPL
	select IMX8M_LPDDR4
endchoice

config SDRAM_SIZE_4GB
       bool "Support 4GB LPDDR4 IWG34M Platform"
       depends on TARGET_IMX8MM_IWG34M

source "board/freescale/imx8mq_evk/Kconfig"
source "board/freescale/imx8mq_val/Kconfig"
source "board/freescale/imx8mm_ab2/Kconfig"
source "board/freescale/imx8mm_evk/Kconfig"
source "board/freescale/imx8mm_iwg34m/Kconfig"
source "board/freescale/imx8mm_iwg34m_q7/Kconfig"
source "board/freescale/imx8mm_iwg34s/Kconfig"
source "board/freescale/imx8mm_val/Kconfig"
source "board/freescale/imx8mn_evk/Kconfig"
source "board/freescale/imx8mn_iwg37m/Kconfig"
source "board/freescale/imx8mn_iwg37m_q7/Kconfig"
source "board/freescale/imx8mn_iwg37s/Kconfig"
source "board/freescale/imx8mp_evk/Kconfig"
source "board/gateworks/venice/Kconfig"
source "board/google/imx8mq_phanbell/Kconfig"
source "board/technexion/pico-imx8mq/Kconfig"
source "board/toradex/verdin-imx8mm/Kconfig"
source "board/beacon/imx8mm/Kconfig"
source "board/beacon/imx8mn/Kconfig"
source "board/phytec/phycore_imx8mm/Kconfig"
source "board/phytec/phycore_imx8mp/Kconfig"

endif
```

## board/freescale/imx8mm_iwg34m/Kconfig
```kconfig
if TARGET_IMX8MM_IWG34M

config SYS_BOARD
	default "imx8mm_iwg34m"

config SYS_VENDOR
	default "freescale"

config SYS_CONFIG_NAME
	default "imx8mm_iwg34m"

config SDRAM_SIZE_1GB
        bool "Support 1GB LPDDR4"
        help
         Enable support for IWG34M 1GB LPDDR4 platform

config SDRAM_SIZE_2GB
        bool "Support 2GB LPDDR4"
        help
         Enable support for IWG34M 2GB LPDDR4 platform

config SDRAM_SIZE_4GB
        bool "Support 4GB LPDDR4"
        help
         Enable support for IWG34M 4GB LPDDR4 platform

config TARGET_IMX8MM_IWG34M_UUU
        bool "imx8mm LPDDR4 IWG34M board UUU"
        help
         Enable UUU tool Support for IWG34M platform

config IMX_CONFIG
	default "board/freescale/imx8mm_iwg34m/imximage-8mm.cfg"

source "board/freescale/common/Kconfig"

endif
```

## board/freescale/imx8mm_iwg34m_q7/Kconfig
```kconfig
if TARGET_IMX8MM_IWG34M_Q7

config SYS_BOARD
	default "imx8mm_iwg34m_q7"

config SYS_VENDOR
	default "freescale"

config SYS_CONFIG_NAME
	default "imx8mm_iwg34m_q7"

config SDRAM_SIZE_1GB
        bool "Support 1GB LPDDR4"
        help
         Enable support for IWG34M 1GB LPDDR4 platform

config SDRAM_SIZE_2GB
        bool "Support 2GB LPDDR4"
        help
         Enable support for IWG34M 2GB LPDDR4 platform

config TARGET_IMX8MM_IWG34M_Q7_UUU 
        bool "imx8mm LPDDR4 IWG34M board UUU"
        help
         Enable UUU tool Support for IWG34M platform

config IMX_CONFIG
	default "board/freescale/imx8mm_iwg34m_q7/imximage-8mm.cfg"

source "board/freescale/common/Kconfig"

endif
```

## board/freescale/imx8mm_iwg34s/Kconfig
```kconfig
if TARGET_IMX8MM_IWG34S

config SYS_BOARD
	default "imx8mm_iwg34s"

config SYS_VENDOR
	default "freescale"

config SYS_CONFIG_NAME
	default "imx8mm_iwg34s"

config SDRAM_SIZE_1GB
	bool "Support 1GB LPDDR4"
	help 
	 Enable support for IWG34S 1GB LPDDR4 platform

config SDRAM_SIZE_2GB
	bool "Support 2GB LPDDR4"
	help 
	 Enable support for IWG34S 2GB LPDDR4 platform

config SDRAM_SIZE_4GB
	bool "Support 4GB LPDDR4"
	help 
	 Enable support for IWG34S 4GB LPDDR4 platform

config SDRAM_SIZE_8GB
	bool "Support 8GB LPDDR4"
	help 
	 Enable support for IWG34S 8GB LPDDR4 platform

config TARGET_IMX8MM_IWG34S_UUU
	bool "imx8mm LPDDR4 IWG34S board UUU"	
	help 
	 Enable UUU tool Support for IWG34S platform

source "board/freescale/common/Kconfig"

endif
```

## board/freescale/imx8mn_iwg37m/Kconfig
```kconfig
if TARGET_IMX8MN_IWG37M

config SYS_BOARD
	default "imx8mn_iwg37m"

config SYS_VENDOR
	default "freescale"

config SYS_CONFIG_NAME
	default "imx8mn_iwg37m"

config SDRAM_SIZE_1GB
        bool "Support 1GB LPDDR4"
        help
         Enable support for IWG37M 1GB LPDDR4 platform

config SDRAM_SIZE_2GB
        bool "Support 2GB LPDDR4"
        help
         Enable support for IWG37M 2GB LPDDR4 platform

config TARGET_IMX8MN_IWG37M_UUU 
        bool "imx8mn LPDDR4 IWG37M board UUU"
        help
         Enable UUU tool Support for IWG37M platform

config IMX_CONFIG
	default "board/freescale/imx8mn_iwg37m/imximage-8mn-ddr4.cfg"

source "board/freescale/common/Kconfig"

endif
```

## board/freescale/imx8mn_iwg37m_q7/Kconfig
```kconfig
if TARGET_IMX8MN_IWG37M_Q7

config SYS_BOARD
	default "imx8mn_iwg37m_q7"

config SYS_VENDOR
	default "freescale"

config SYS_CONFIG_NAME
	default "imx8mn_iwg37m_q7"

config SDRAM_SIZE_1GB
        bool "Support 1GB LPDDR4"
        help
         Enable support for IWG37M 1GB LPDDR4 platform

config SDRAM_SIZE_2GB
        bool "Support 2GB LPDDR4"
        help
         Enable support for IWG37M 2GB LPDDR4 platform

config TARGET_IMX8MN_IWG37M_Q7_UUU 
        bool "imx8mn LPDDR4 IWG37M board UUU"
        help
         Enable UUU tool Support for IWG37M platform

config IMX_CONFIG
	default "board/freescale/imx8mn_iwg37m_q7/imximage-8mn-ddr4.cfg"

source "board/freescale/common/Kconfig"

endif
```

## board/freescale/imx8mn_iwg37s/Kconfig
```kconfig
if TARGET_IMX8MN_IWG37S

config SYS_BOARD
	default "imx8mn_iwg37s"

config SYS_VENDOR
	default "freescale"

config SYS_CONFIG_NAME
	default "imx8mn_iwg37s"

config SDRAM_SIZE_1GB
	bool "Support 1GB LPDDR4"
	help
	 Enable support for IWG34S 1GB LPDDR4 platform

config SDRAM_SIZE_2GB
	bool "Support 2GB LPDDR4"
	help
	 Enable support for IWG34S 2GB LPDDR4 platform

config TARGET_IMX8MN_IWG37S_UUU
	bool "imx8mn LPDDR4 IWG37S board UUU"
	help
	 Enable UUU tool Support for IWG37S platform

config IMX_CONFIG
	default "board/freescale/imx8mn_iwg37s/imximage-8mn-ddr4.cfg"

source "board/freescale/common/Kconfig"

endif
```

## board/freescale/imx8mp_iwg40m/Kconfig
```kconfig
if TARGET_IMX8MP_IWG40M

config SYS_BOARD
	default "imx8mp_iwg40m"

config SYS_VENDOR
	default "freescale"

config SYS_CONFIG_NAME
	default "imx8mp_iwg40m"

config TYPEC
        bool "iWave USB Type-C support"
        default y

source "board/freescale/common/Kconfig"

endif
```

## board/freescale/imx8qm_iwg27s/Kconfig
```kconfig
if TARGET_IMX8QM_IWG27S_UUU

config SYS_BOARD
        default "imx8qm_iwg27s"

config SYS_VENDOR
        default "freescale"

config SYS_CONFIG_NAME
        default "imx8qm_iwg27s_uuu"

endif

if TARGET_IMX8QM_IWG27S

config SYS_BOARD
	default "imx8qm_iwg27s"

config SYS_VENDOR
	default "freescale"

config SYS_CONFIG_NAME
	default "imx8qm_iwg27s"

source "board/freescale/common/Kconfig"

endif
```
